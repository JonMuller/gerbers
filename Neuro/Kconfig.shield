## Neuro/Kconfig.shield
```kconfig
# Copyright (c) 2020 Pete Johanson
# SPDX-License-Identifier: MIT

config SHIELD_NEUROPHANTE_LEFT
	def_bool $(shields_list_contains,neurophante_left)

config SHIELD_NEUROPHANTE_RIGHT
	def_bool $(shields_list_contains,neurophante_right)
```

## corne-choc-xiao/Kconfig.shield
```kconfig
# Copyright (c) 2020 Pete Johanson
# SPDX-License-Identifier: MIT

config SHIELD_CHIPPER_LEFT
	def_bool $(shields_list_contains,chipper_left)

config SHIELD_CHIPPER_RIGHT
	def_bool $(shields_list_contains,chipper_right)
```

## corne-choc-xiao/zmk_starter/OLED/Kconfig.shield
```kconfig
# Copyright (c) 2020 Pete Johanson
# SPDX-License-Identifier: MIT

config SHIELD_CHIPPY_LEFT
	def_bool $(shields_list_contains,chippy_left)

config SHIELD_CHIPPY_RIGHT
	def_bool $(shields_list_contains,chippy_right)
```

## corne-choc-xiao/zmk_starter/view/Kconfig.defconfig
```kconfig
if SHIELD_CHIPPER_LEFT

config ZMK_KEYBOARD_NAME
	default "Chipper"

config ZMK_SPLIT_BLE_ROLE_CENTRAL
	default y

endif

if SHIELD_CHIPPER_RIGHT

config ZMK_KEYBOARD_NAME
	default "Chipper Right"
	
endif

if SHIELD_CHIPPER_LEFT || SHIELD_CHIPPER_RIGHT

config ZMK_SPLIT
	default y
 

config ZMK_DISPLAY
	select LV_FONT_MONTSERRAT_26


if ZMK_DISPLAY

config SPI
	default y

config LS0XX
	default y

config LV_Z_BITS_PER_PIXEL
	default 1

choice LV_COLOR_DEPTH
	default LV_COLOR_DEPTH_1

endchoice

config LV_DPI_DEF
	default 30

config LV_Z_VDB_SIZE
	default 16

endif # ZMK_DISPLAY

endif
```

## tenax-XIAO/zmk_starter/oled/Kconfig.shield
```kconfig
# Copyright (c) 2020 Pete Johanson
# SPDX-License-Identifier: MIT

config SHIELD_TENAXOLED_LEFT
	def_bool $(shields_list_contains,tenaxoled_left)

config SHIELD_TENAXOLED_RIGHT
	def_bool $(shields_list_contains,tenaxoled_right)
```

## tenax-XIAO/zmk_starter/view/Kconfig.defconfig
```kconfig
if SHIELD_TENAXXIAO_LEFT

config ZMK_KEYBOARD_NAME
	default "tenaxXIAO"

config ZMK_SPLIT_BLE_ROLE_CENTRAL
	default y

endif


if SHIELD_TENAXXIAO_RIGHT

config ZMK_KEYBOARD_NAME
	default "tenaxxiao Right"
	
endif


if SHIELD_TENAXXIAO_LEFT || SHIELD_TENAXXIAO_RIGHT

config ZMK_SPLIT
	default y
	

config ZMK_DISPLAY
	select LV_FONT_MONTSERRAT_26


if ZMK_DISPLAY

config SPI
	default y

config LS0XX
	default y

config LV_Z_BITS_PER_PIXEL
	default 1

choice LV_COLOR_DEPTH
	default LV_COLOR_DEPTH_1

endchoice

config LV_DPI_DEF
	default 30

config LV_Z_VDB_SIZE
	default 16

endif # ZMK_DISPLAY

endif
```

## tenax-XIAO/zmk_starter/view/Kconfig.shield
```kconfig
# Copyright (c) 2020 Pete Johanson
# SPDX-License-Identifier: MIT

config SHIELD_TENAXXIAO_LEFT
	def_bool $(shields_list_contains,tenaxxiao_left)

config SHIELD_TENAXXIAO_RIGHT
	def_bool $(shields_list_contains,tenaxxiao_right)
```
