/*
 * Copyright (c) 2020 Pete Johanson
 *
 * SPDX-License-Identifier: MIT
 */

#include "neurophante.dtsi"

&default_transform {
	col-offset = <6>;
};

&kscan0 {
	col-gpios
		= <&gpio0 22 GPIO_ACTIVE_HIGH>	//Col0
		, <&gpio0 24 GPIO_ACTIVE_HIGH>  //Col1
		, <&gpio1 00 GPIO_ACTIVE_HIGH>  //Col2
		, <&gpio1 11 GPIO_ACTIVE_HIGH>  //Col3
		, <&gpio1 04 GPIO_ACTIVE_HIGH>  //Col4
		, <&gpio1 06 GPIO_ACTIVE_HIGH>  //Col5
		;
};
