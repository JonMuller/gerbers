/*
 * Copyright (c) 2020 Pete Johanson
 *
 * SPDX-License-Identifier: MIT
 */

#include "tenaxoled.dtsi"

&kscan0 {
	col-gpios
		= <&gpio1 11 GPIO_ACTIVE_HIGH>   //Col0
		, <&gpio1 12 GPIO_ACTIVE_HIGH>   //Col1
		, <&gpio1 13 GPIO_ACTIVE_HIGH>   //Col2
		, <&gpio1 14 GPIO_ACTIVE_HIGH>   //Col3
		, <&gpio1 15 GPIO_ACTIVE_HIGH>   //Col4
		;
};

